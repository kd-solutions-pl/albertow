## meta-albertow/conf/distro/albertow.conf
```bitbake
DISTRO_NAME = "Albertow"
DISTRO_VERSION = "1.0"
DISTRO_FEATURES = "systemd"

INIT_MANAGER ??= "systemd"
VIRTUAL-RUNTIME_syslog = ""
VIRTUAL-RUNTIME_base-utils-syslog = ""
```
